/* Copyright (c) 2015, The Linux Foundation. All rights reserved.
 *
 * This program is free software; you can redistribute it and/or modify
 * it under the terms of the GNU General Public License version 2 and
 * only version 2 as published by the Free Software Foundation.
 *
 * This program is distributed in the hope that it will be useful,
 * but WITHOUT ANY WARRANTY; without even the implied warranty of
 * MERCHANTABILITY or FITNESS FOR A PARTICULAR PURPOSE.  See the
 * GNU General Public License for more details.
 */

/*---------------------------------------------------------------------------
 * This file is autogenerated file using gcdb parser. Please do not edit it.
 * Update input XML file to add a new entry or update variable in this file
 * VERSION = "1.0"
 *---------------------------------------------------------------------------*/
&soc {
	dsi_ss_fhd_ea8076_global_cmd: qcom,mdss_dsi_ss_fhd_ea8076_global_cmd {
		qcom,mdss-dsi-panel-name = "samsung ea8076 fhd cmd dsi panel";
		qcom,mdss-dsi-panel-id = <0>;
		qcom,mdss-dsi-panel-model = "SAMSUNG FHD EA8076 CMD PANEL";

		qcom,mdss-dsi-panel-type = "dsi_cmd_mode";
		qcom,dsi-ctrl-num = <0>;
		qcom,dsi-phy-num = <0>;

		qcom,mdss-dsi-virtual-channel-id = <0>;
		qcom,mdss-dsi-bpp = <24>;
		qcom,mdss-dsi-color-order = "rgb_swap_rgb";
		qcom,mdss-dsi-traffic-mode = "burst_mode";
		qcom,mdss-dsi-lane-map = "lane_map_0123";
		qcom,mdss-dsi-lane-0-state;
		qcom,mdss-dsi-lane-1-state;
		qcom,mdss-dsi-lane-2-state;
		qcom,mdss-dsi-lane-3-state;

		qcom,mdss-dsi-dma-trigger = "trigger_sw";
		qcom,mdss-dsi-mdp-trigger = "none";
		qcom,mdss-dsi-wr-mem-start = <0x2c>;
		qcom,mdss-dsi-wr-mem-continue = <0x3c>;

		qcom,mdss-dsi-te-pin-select = <1>;
		qcom,mdss-dsi-te-dcs-command = <1>;
		qcom,mdss-dsi-te-check-enable;
		qcom,mdss-dsi-te-using-te-pin;
		qcom,mdss-dsi-tx-eot-append;
		qcom,mdss-dsi-dma-schedule-line = <5>;

		qcom,mdss-dsi-bl-dcs-type-ss;
		qcom,mdss-dsi-bl-pmic-control-type = "bl_ctrl_dcs";
		qcom,mdss-dsi-bl-min-level = <4>;
		qcom,mdss-dsi-bl-max-level = <2047>;
		qcom,mdss-brightness-max-level = <1023>;
		qcom,mdss-brightness-init-level = <268>; // Let's follow same init brightness as the ROM
		qcom,bl-update-flag = "delay_until_first_frame";

		qcom,mdss-dsi-reset-sequence = <0 1>, <1 10>;
		qcom,mdss-dsi-lp11-init;

		qcom,mdss-pan-physical-width-dimension = <68>;
		qcom,mdss-pan-physical-height-dimension = <147>;

		qcom,disp-doze-lpm-backlight = <25>;
		qcom,disp-doze-hbm-backlight = <266>;
		qcom,disp-fod-off-dimming-delay = <0>;
		qcom,disp-fod-dim-lut = <
			/* brightness, alpha */
			0	0xFF
			2	0xF1
			4	0xED
			6	0xEC
			8	0xEA
			12	0xE6
			20	0xDF
			40	0xD5
			60	0xD0
			90	0xC5
			140	0xB7
			200	0xAD
			300	0xA4
			454	0x8D
			600	0x7E
			800	0x68
			1000	0x5A
			1200	0x4B
			1600	0x32
			2047	0x19
			2047	0x19
		>;

		qcom,mdss-dsi-display-timings {
			timing@0{
				qcom,mdss-dsi-panel-framerate = <60>;
				qcom,mdss-dsi-panel-width = <1080>;
				qcom,mdss-dsi-panel-height = <2340>;
				qcom,mdss-dsi-h-front-porch = <64>;
				qcom,mdss-dsi-h-back-porch = <64>;
				qcom,mdss-dsi-h-pulse-width = <32>;
				qcom,mdss-dsi-h-sync-skew = <0>;
				qcom,mdss-dsi-h-sync-pulse = <0>;
				qcom,mdss-dsi-v-back-porch = <34>;
				qcom,mdss-dsi-v-front-porch = <34>;
				qcom,mdss-dsi-v-pulse-width = <20>;
				qcom,mdss-dsi-h-left-border = <0>;
				qcom,mdss-dsi-h-right-border = <0>;
				qcom,mdss-dsi-v-top-border = <0>;
				qcom,mdss-dsi-v-bottom-border = <0>;
				qcom,mdss-dsi-panel-clockrate = <1103000000>;
				qcom,mdss-mdp-transfer-time-us = <14000>;
				qcom,mdss-dsi-on-command = [
					/* 1 Sleep Out */
					05 01 00 00 0A 00 02 11 00            /* Sleep Out */
					/* 3 Common Setting */
					/* 3.1 TE(Vsync) On/Off */
					39 01 00 00 00 00 02 35 00            /* TE On(Vsync) */
					/* 3.2 CASET/PASET Setting */
					39 00 00 00 00 00 05 2A 00 00 04 37     /* CASET */
					39 01 00 00 00 00 05 2B 00 00 09 5F     /* PASET */
					/* 3.3 11Bit Dimming Setting */
					39 01 00 00 00 00 03 F0 5A 5A
					39 00 00 00 00 00 02 B0 01            /* Global para */
					39 01 00 00 00 00 02 B7 4F            /* 11Bit Dimming On*/
					39 01 00 00 00 00 03 F0 A5 A5
					/* 3.4 Err FG Setting*/
					39 01 00 00 00 00 03 F0 5A 5A
					39 00 00 00 00 00 02 B0 02
					39 00 00 00 00 00 05 EC 00 C0 C3 43
					39 00 00 00 00 00 02 B0 0D
					39 00 00 00 00 00 02 EC 19
					39 00 00 00 00 00 02 B0 06
					39 01 00 00 00 00 02 E4 D0
					39 01 00 00 00 00 03 F0 A5 A5
					/* 3.5 Ripple improvement Setting*/
					39 01 00 00 00 00 03 F0 5A 5A
					39 00 00 00 00 00 02 B0 36
					39 00 00 00 00 00 02 D3 0F
					39 01 00 00 00 00 02 F7 03
					39 01 00 00 00 00 03 F0 A5 A5
					/* 3.6 OFC (MIPI 1100Mbps/Lane, OSC 108.5Mhz)*/
					39 01 00 00 00 00 03 F0 5A 5A
					39 01 00 00 00 00 03 FC 5A 5A
					39 00 00 00 00 00 02 B0 01
					39 00 00 00 00 00 04 E4 A6 75 A3
					39 01 00 00 00 00 0F E9 11 75 A6 75 A3 8D 06 20 8C A2 4E 00 32 32
					39 01 00 00 00 00 03 FC A5 A5
					39 01 00 00 00 00 03 F0 A5 A5
					/* tsp_vsync tsp_hsync*/
					39 01 00 00 00 00 03 F0 5A 5A
					39 00 00 00 00 00 04 DF 83 00 10
					39 00 00 00 00 00 02 B0 01
					39 01 00 00 00 00 02 E6 01
					39 01 00 00 00 00 03 F0 A5 A5
					/* flicker */
					39 00 00 00 00 00 03 F0 5A 5A
					39 00 00 00 00 00 02 B0 08
					39 00 00 00 00 00 02 D4 05
					39 01 00 00 00 00 03 F0 A5 A5
					/* 3.7 Hporch Setting */
					39 01 00 00 00 00 03 F0 5A 5A
					39 01 00 00 00 00 03 FC 5A 5A
					39 00 00 00 00 00 02 B0 16
					39 01 00 00 00 00 02 D1 2E
					39 01 00 00 00 00 03 FC A5 A5
					39 01 00 00 5A 00 03 F0 A5 A5
					/* Dimming Setting*/
					39 01 00 00 00 00 03 F0 5A 5A
					39 00 00 00 00 00 02 B0 06
					39 00 00 00 00 00 02 B7 20                /* Dimming Speed Setting : 0x20 : 32Frames*/
					39 00 00 00 00 00 02 B0 05
					39 01 00 00 00 00 02 B7 93                /* 0x93 : ELVSS DIM ON */
					39 01 00 00 00 00 03 F0 A5 A5
					39 01 00 00 00 00 02 53 20
					39 01 00 00 00 00 03 51 00 00             /* Write Display Brightness */
					/* 5 Display On */
					05 01 00 00 00 00 02 29 00
				];
				qcom,mdss-dsi-off-command = [
					05 01 00 00 14 00 02 28 00
					05 01 00 00 78 00 02 10 00
				];

				qcom,mdss-dsi-on-command-state = "dsi_lp_mode";
				qcom,mdss-dsi-off-command-state = "dsi_lp_mode";

				qcom,mdss-dsi-lp1-command = [
					05 01 00 00 00 00 02 28 00
					39 00 00 00 00 00 03 F0 5A 5A
					39 00 00 00 00 00 02 60 00
					39 00 00 00 00 00 03 FC 5A 5A
					39 00 00 00 00 00 02 B0 16
					39 00 00 00 00 00 02 D1 2E
					39 00 00 00 00 00 03 FC A5 A5
					39 00 00 00 00 00 02 B0 0B
					39 00 00 00 00 00 03 D8 50 00
					15 00 00 00 00 00 02 53 23
					39 01 00 00 22 00 03 F0 A5 A5
					05 01 00 00 00 00 02 29 00];
				qcom,mdss-dsi-lp1-command-state = "dsi_lp_mode";

				qcom,mdss-dsi-nolp-command = [
					/* Display Off (Wait 16ms: 0x10) */
					05 01 00 00 10 00 02 28 00
					/* HBM off + Disable brightness dimming */
					15 01 00 00 00 00 02 53 20
					/* Display on (29h) */
					05 01 00 00 00 00 02 29 00
				];
				qcom,mdss-dsi-nolp-command-state = "dsi_lp_mode";

				qcom,mdss-dsi-doze-hbm-command = [
					05 01 00 00 00 00 02 28 00
					39 00 00 00 00 00 03 F0 5A 5A
					39 00 00 00 00 00 02 60 00
					39 00 00 00 00 00 03 FC 5A 5A
					39 00 00 00 00 00 02 B0 16
					39 00 00 00 00 00 02 D1 2E
					39 00 00 00 00 00 03 FC A5 A5
					39 00 00 00 00 00 02 B0 0B
					39 00 00 00 00 00 03 D8 50 00
					39 00 00 00 00 00 02 53 22
					39 01 00 00 22 00 03 F0 A5 A5
					05 01 00 00 00 00 02 29 00
				];
				qcom,mdss-dsi-doze-lbm-command = [
					05 01 00 00 00 00 02 28 00
					39 00 00 00 00 00 03 F0 5A 5A
					39 00 00 00 00 00 02 60 00
					39 00 00 00 00 00 03 FC 5A 5A
					39 00 00 00 00 00 02 B0 16
					39 00 00 00 00 00 02 D1 2E
					39 00 00 00 00 00 03 FC A5 A5
					39 00 00 00 00 00 02 B0 0B
					39 00 00 00 00 00 03 D8 50 00
					39 00 00 00 00 00 02 53 23
					39 01 00 00 22 00 03 F0 A5 A5
					05 01 00 00 00 00 02 29 00
				];

				qcom,mdss-dsi-doze-hbm-command-state = "dsi_lp_mode";
				qcom,mdss-dsi-doze-lbm-command-state = "dsi_lp_mode";

				qcom,mdss-dsi-dispparam-hbm-off-command = [
					39 01 00 00 00 00 02 53 28
					39 01 00 00 00 00 03 51 07 FF
				];
				qcom,mdss-dsi-dispparam-hbm-off-command-state = "dsi_lp_mode";

				qcom,mdss-dsi-dispparam-hbm-on-command = [
					39 01 00 00 00 00 02 53 E8
					39 01 00 00 00 00 03 51 00 00
				];
				qcom,mdss-dsi-dispparam-hbm-on-command-state = "dsi_lp_mode";

				qcom,mdss-dsi-dispparam-dimmingon-command = [39 01 00 00 00 00 02 53 28];
				qcom,mdss-dsi-dispparam-dimmingon-command-state = "dsi_hs_mode";
				qcom,mdss-dsi-dispparam-dimmingoff-command = [39 01 00 00 00 00 02 53 20];
				qcom,mdss-dsi-dispparam-dimmingoff-command-state = "dsi_hs_mode";
				qcom,mdss-dsi-dispparam-crc-srgb-on-command = [
					/* CRC Enable + sRGB mode */
					39 01 00 00 00 00 02 81 90
					39 01 00 00 00 00 03 F0 5A 5A
					/* CRC Enable */
					39 01 00 00 00 00 02 B1 00
					/* Set Offset P2*/
					39 01 00 00 00 00 02 B0 01
					/* CRC LUT(sRGB mode) */
					39 01 00 00 00 00 16 B1 AE 0C 05 3F C6 14 05 07 AA 4A DD C8 C3 14 C0 E8 DC 19 FF F4 D9
					/* Set Offset P23*/
					39 01 00 00 00 00 02 B0 16
					/* CRC LUT(DCI-P3 mode) */
					39 01 00 00 00 00 16 B1 BD 02 00 14 D1 00 04 07 AA 0C EC CB C8 0F DD D9 E4 05 FF FF FF
					39 01 00 00 00 00 03 F0 A5 A5
				];
				qcom,mdss-dsi-dispparam-crc-srgb-on-command-state = "dsi_lp_mode";
				qcom,mdss-dsi-dispparam-crc-dcip3-on-command = [
					/* CRC Enable + DCI-P3 mode */
					39 01 00 00 00 00 02 81 91
					39 01 00 00 00 00 03 F0 5A 5A
					/* CRC Enable */
					39 01 00 00 00 00 02 B1 00
					/* Set Offset P2*/
					39 01 00 00 00 00 02 B0 01
					/* CRC LUT(sRGB mode) */
					39 01 00 00 00 00 16 B1 AE 0C 05 3F C6 14 05 07 AA 4A DD C8 C3 14 C0 E8 DC 19 FF F4 D9
					/* Set Offset P23*/
					39 01 00 00 00 00 02 B0 16
					/* CRC LUT(DCI-P3 mode) */
					39 01 00 00 00 00 16 B1 D2 0A 05 1A E6 00 04 07 F5 0C DC DB E8 0F DD EE E9 05 FF FF FF
					39 01 00 00 00 00 03 F0 A5 A5
				];
				qcom,mdss-dsi-dispparam-crc-dcip3-on-command-state = "dsi_lp_mode";
				qcom,mdss-dsi-dispparam-crc-off-command = [
					/* CRC Disable (Normal mode) */
					39 01 00 00 00 00 02 81 00
					39 00 00 00 00 00 03 F0 5A 5A
					/* CRC Bypass */
					39 00 00 00 00 00 02 B1 01
					39 01 00 00 00 00 03 F0 A5 A5
				];
				qcom,mdss-dsi-dispparam-crc-off-command-state = "dsi_lp_mode";
				qcom,mdss-dsi-dispparam-elvss-dimming-off-command = [
					/* Test Key Enable: F0 */
					39 00 00 00 00 00 03 F0 5A 5A
					/* Elvss Dimming Setting (0x91: ELVSS DIM OFF) */
					39 00 00 00 00 00 02 B0 07
					39 00 00 00 00 00 02 B7 91
					/* Test Key Disable: F0 */
					39 01 00 00 01 00 03 F0 A5 A5
				];
				qcom,mdss-dsi-dispparam-elvss-dimming-off-command-state = "dsi_lp_mode";

				qcom,mdss-dsi-dispparam-hbm-fod-on-command = [
					/* ELVSS DIM Off */
					39 00 00 00 00 00 03 F0 5A 5A
					39 00 00 00 00 00 02 B0 02
					39 00 00 00 00 00 02 B5 93
					39 01 00 00 07 00 03 F0 A5 A5
					/* HBM mode On */
					15 01 00 00 10 00 02 53 E0
					15 01 00 00 00 00 02 FE 00
					/* HBM mode setting */
					39 00 00 00 00 00 03 F0 5A 5A
					39 00 00 00 00 00 02 C7 27
					39 00 00 00 00 00 02 B0 34
					39 00 00 00 00 00 02 B1 4B
					39 00 00 00 00 00 02 B0 06
					39 00 00 00 00 00 20 B1
					00 00 00 0F 03 E1 02 0A
					14 1E 33 66 00 FF 00 00
					00 00 00 00 02 0A 14 1E
					33 47 66 85 A4 C2 E1
					39 00 00 00 00 00 02 B0 03
					39 00 00 00 00 00 1B B5
					14 14 14 14 14 14 14 14
					14 14 14 14 14 14 14 14
					14 14 14 14 14 14 14 14
					14 14
					39 00 00 00 00 00 02 B0 17
					39 00 00 00 00 00 02 95 30
					39 01 00 00 00 00 03 F0 A5 A5
				];
				qcom,mdss-dsi-dispparam-hbm-fod-on-command-state = "dsi_hs_mode";
				qcom,mdss-dsi-dispparam-hbm-fod-off-command = [
					/* DLY On */
					39 00 00 00 00 00 03 F0 5A 5A
					39 00 00 00 00 00 02 B0 02
					39 00 00 00 00 00 02 B5 13
					39 01 00 00 07 00 03 F0 A5 A5
					/* HBM mode off */
					15 01 00 00 10 00 02 53 20
					15 00 00 00 03 00 02 FE 00
					39 00 00 00 00 00 03 F0 5A 5A
					39 00 00 00 00 00 02 C7 23
					39 00 00 00 00 00 02 B0 34
					39 00 00 00 00 00 02 B1 5D
					39 00 00 00 00 00 02 B0 06
					39 00 00 00 00 00 20 B1
					30 00 00 16 0F 85 08 29
					52 7B CD 9A 65 FF 00 00
					01 12 23 30 08 29 52 7B
					CD 1F 9A 15 90 0A 85
					39 00 00 00 00 00 02 B0 03
					39 00 00 00 00 00 1B B5
					50 50 50 50 50 50 50 50
					50 50 50 50 50 50 50 50
					50 50 50 50 50 50 50 50
					50 50
					39 00 00 00 00 00 02 B0 17
					39 00 00 00 00 00 02 95 00
					39 01 00 00 00 00 03 F0 A5 A5
				];
				qcom,mdss-dsi-dispparam-hbm-fod-off-command-state = "dsi_hs_mode";
			};
		};
	};
};
